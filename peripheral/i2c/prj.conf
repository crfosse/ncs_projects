## CMakeLists.txt
```
#
# Copyright (c) 2018 Nordic Semiconductor
#
# SPDX-License-Identifier: LicenseRef-BSD-5-Clause-Nordic
#

cmake_minimum_required(VERSION 3.8.2)

set (spm_DTS_OVERLAY_FILE ${cmake_current_source_dir}/nrf9160_nrf9160.overlay)

find_package(Zephyr REQUIRED HINTS $ENV{ZEPHYR_BASE})
project(NONE)

# NORDIC SDK APP START
target_sources(app PRIVATE src/main.c)
# NORDIC SDK APP END
```

## prj.conf
```kconfig
#
# Copyright (c) 2019 Nordic Semiconductor ASA
#
# SPDX-License-Identifier: LicenseRef-BSD-5-Clause-Nordic
#
# General config
CONFIG_ASSERT=y

# Logging
CONFIG_UART_CONSOLE=y
CONFIG_SERIAL=y

# Stacks and heaps
CONFIG_MAIN_STACK_SIZE=3072
CONFIG_HEAP_MEM_POOL_SIZE=16384

# I2C
CONFIG_I2C=y
CONFIG_I2C_NRFX=y
CONFIG_I2C_1=y
CONFIG_NRFX_TWIM1=y

#QSPI
CONFIG_NORDIC_QSPI_NOR=y
CONFIG_FLASH=y

# Rebooot
CONFIG_REBOOT=y
```

## nrf5340pdk_nrf5340_cpuappns.overlay
```dts
&i2c1 {
	status = "okay";
	compatible = "nordic,nrf-twim";
	sda-pin = <34>;
	scl-pin = <4>;
	clock-frequency = <100000>; 
};
```

## nrf9160dk_nrf9160ns.overlay
```dts
&i2c1 {
	status = "okay";
	compatible = "nordic,nrf-twim";
	sda-pin = <10>;
	scl-pin = <11>;
	clock-frequency = <100000>; 
};
```

## src/main.c
```c
/*
 * Copyright (c) 2018 Nordic Semiconductor ASA
 *
 * SPDX-License-Identifier: LicenseRef-BSD-5-Clause-Nordic
 */

#include <zephyr.h>
#include <stdio.h>
#include <string.h>
#include <stdlib.h>
#include <drivers/i2c.h>
#include <device.h>

/**@brief Recoverable BSD library error. */
void bsd_recoverable_error_handler(uint32_t err)
{
	printk("bsdlib recoverable error: %u\n", err);
}
void main(void)
{
	printk("The I2C scanner started\n");
    const struct device *i2c_dev;
	int error;

    i2c_dev = device_get_binding("I2C_1");
    if (!i2c_dev) {
        printk("Binding failed.");
        return;
    }
    i2c_configure(i2c_dev, I2C_SPEED_SET(I2C_SPEED_STANDARD));

    printk("Value of NRF_TWIM2_NS->PSEL.SCL : %d \n",NRF_TWIM1_NS->PSEL.SCL);
	printk("Value of NRF_TWIM2_NS->PSEL.SDA : %d \n",NRF_TWIM1_NS->PSEL.SDA);
	printk("Value of NRF_TWIM2_NS->FREQUENCY: %d \n",NRF_TWIM1_NS->FREQUENCY);
	printk("26738688 -> 100k\n");
        
    for (uint8_t i = 4; i <= 0x7F; i++) {
		struct i2c_msg msgs[1];
		uint8_t dst = 1;

		msgs[0].buf = &dst;
		msgs[0].len = 1U;
		msgs[0].flags = I2C_MSG_WRITE | I2C_MSG_STOP;
		
		error = i2c_transfer(i2c_dev, &msgs[0], 1, i);
		if (error == 0) {
			printk("0x%2x FOUND\n", i);
		}
		else {
			//printk("error %d \n", error);
		}
		
	}
}
```
