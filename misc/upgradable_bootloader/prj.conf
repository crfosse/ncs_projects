## CMakeLists.txt
```
# SPDX-License-Identifier: Apache-2.0

cmake_minimum_required(VERSION 3.13.1)

find_package(Zephyr HINTS $ENV{ZEPHYR_BASE})
project(hello_world)

target_sources(app PRIVATE src/main.c)
```

## Kconfig
```
menu "Zephyr Kernel"
source "$ZEPHYR_BASE/Kconfig.zephyr"
endmenu

module = MCUBOOT_DEMO
module-str = MCUBoot Demo
source "${ZEPHYR_BASE}/subsys/logging/Kconfig.template.log_config"
```

## prj.conf
```kconfig
# nothing here
CONFIG_SECURE_BOOT=y
CONFIG_SB_SIGNING_KEY_FILE="keys/priv.pem"
CONFIG_BOOTLOADER_MCUBOOT=y
CONFIG_BUILD_S1_VARIANT=y

# Enable mcumgr.
CONFIG_MCUMGR=y
CONFIG_MCUBOOT_IMAGE_VERSION="0.0.0+1"

# RTT logging
CONFIG_RTT_CONSOLE=y
CONFIG_USE_SEGGER_RTT=y
CONFIG_SHELL=y
CONFIG_LOG=y
CONFIG_UART_CONSOLE=n
CONFIG_MCUBOOT_DEMO_LOG_LEVEL_DBG=y

# Enable most core commands.
CONFIG_MCUMGR_CMD_IMG_MGMT=y
CONFIG_MCUMGR_CMD_OS_MGMT=y
```

## src/main.c
```c
/*
 * Copyright (c) 2012-2014 Wind River Systems, Inc.
 *
 * SPDX-License-Identifier: Apache-2.0
 */

#include <zephyr.h>
#include <sys/printk.h>
#include <stdio.h>

#include <logging/log.h>
#define LOG_MODULE_NAME mcuboot_demo
LOG_MODULE_REGISTER(LOG_MODULE_NAME, CONFIG_MCUBOOT_DEMO_LOG_LEVEL);

#ifdef CONFIG_MCUMGR_CMD_OS_MGMT
#include "os_mgmt/os_mgmt.h"
#endif
#ifdef CONFIG_MCUMGR_CMD_IMG_MGMT
#include "img_mgmt/img_mgmt.h"
#endif

void main(void)
{
	#ifdef CONFIG_MCUMGR_CMD_OS_MGMT
		os_mgmt_register_group();
	#endif
	#ifdef CONFIG_MCUMGR_CMD_IMG_MGMT
		img_mgmt_register_group();
	#endif

	LOG_DBG("Hello World -test! %s\n", CONFIG_BOARD);
}
```
