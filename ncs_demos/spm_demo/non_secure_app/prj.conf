## CMakeLists.txt
```
# SPDX-License-Identifier: Apache-2.0

cmake_minimum_required(VERSION 3.13.1)

list(APPEND ZEPHYR_EXTRA_MODULES
  ${CMAKE_CURRENT_SOURCE_DIR}/../spm_module
)

include($ENV{ZEPHYR_BASE}/cmake/app/boilerplate.cmake NO_POLICY_SCOPE)
project(hello_world)

target_sources(app PRIVATE src/main.c)
```

## prj.conf
```kconfig
# nothing here

CONFIG_TRUSTED_EXECUTION_NONSECURE=y

# PATCHED
CONFIG_SPM_BUILD_STRATEGY_SKIP_BUILD=y
# END PATCHED
```

## src/main.c
```c
/*
 * Copyright (c) 2012-2014 Wind River Systems, Inc.
 *
 * SPDX-License-Identifier: Apache-2.0
 */

#include <zephyr.h>
#include <sys/printk.h>

int spm_read_ficr(void *destination);

void main(void)
{
	printk("Hello World! %s\n", CONFIG_BOARD);

	int32_t HW_ID;

	spm_read_ficr(&HW_ID);
	printk("HW_ID : %d \n", HW_ID);
		
}
```
