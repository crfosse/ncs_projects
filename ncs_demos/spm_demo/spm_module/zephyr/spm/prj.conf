## CMakeLists.txt
```
#
# Copyright (c) 2019 Nordic Semiconductor ASA
#
# SPDX-License-Identifier: LicenseRef-BSD-5-Clause-Nordic
#
cmake_minimum_required(VERSION 3.8.2)

find_package(Zephyr REQUIRED HINTS $ENV{ZEPHYR_BASE})
project(NONE)


zephyr_include_directories(
  kernel/include
  ${ARCH_DIR}/${ARCH}/include
)

zephyr_library_sources(src/main.c)
```

## sample.yaml
```
sample:
  name: spm Sample
tests:
  test_build:
    build_only: true
    build_on_all: true
    platform_whitelist: nrf5340pdk_nrf5340_cpuapp
    tags: ci_build
```

## prj.conf
```kconfig
#
# Copyright (c) 2019 Nordic Semiconductor ASA
#
# SPDX-License-Identifier: LicenseRef-BSD-5-Clause-Nordic
#
CONFIG_IS_SPM=y
CONFIG_FW_INFO=y
CONFIG_GPIO=n

#CONFIG_ARM_ENTRY_VENEERS_LIB_NAME="spm/libspmsecureentries.a"

# PATCHED
CONFIG_REBOOT=y
# END PATCHED
```

## nrf5340pdk_nrf5340_cpuapp.overlay
```dts
/* Needed to get NRF_UARTE2 and NRF_PWMn defined. */
//&uart2 {
//	status = "okay";
//};

&pwm1 {
	status = "okay";
};

&pwm2 {
	status = "okay";
};

&pwm3 {
	status = "okay";
};
```

## src/main.c
```c
/*
 * Copyright (c) 2018 Nordic Semiconductor ASA.
 *
 * SPDX-License-Identifier: LicenseRef-BSD-5-Clause-Nordic
 */

#include <spm.h>
#include <zephyr.h>
#include <sys/printk.h>

/*
 * Example code for a Secure Partition Manager application.
 * The application uses the SPM to set the security attributions of
 * the MCU resources (Flash, SRAM and Peripherals). It uses the core
 * TrustZone-M API to prepare the MCU to jump into Non-Secure firmware
 * execution.
 *
 * The following security configuration for Flash and SRAM is applied:
 *
 *                FLASH
 *  1 MB  |---------------------|
 *        |                     |
 *        |                     |
 *        |                     |
 *        |                     |
 *        |                     |
 *        |     Non-Secure      |
 *        |       Flash         |
 *        |                     |
 * 256 kB |---------------------|
 *        |                     |
 *        |     Secure          |
 *        |      Flash          |
 *  0 kB  |---------------------|
 *
 *
 *                SRAM
 * 256 kB |---------------------|
 *        |                     |
 *        |                     |
 *        |                     |
 *        |     Non-Secure      |
 *        |    SRAM (image)     |
 *        |                     |
 * 128 kB |.................... |
 *        |     Non-Secure      |
 *        |  SRAM (BSD Library) |
 *  64 kB |---------------------|
 *        |      Secure         |
 *        |       SRAM          |
 *  0 kB  |---------------------|
 */


void main(void)
{
	spm_config();
	spm_jump();
}


#include <cortex_m/tz.h>

__TZ_NONSECURE_ENTRY_FUNC
int spm_read_ficr(uint32_t *destination)

	*destination = NRF_FICR->INFO.DEVICEID[0];

	return 0;
}
```
