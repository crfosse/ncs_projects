## CMakeLists.txt
```
#
# Copyright (c) 2018 Nordic Semiconductor
#
# SPDX-License-Identifier: LicenseRef-BSD-5-Clause-Nordic
#

cmake_minimum_required(VERSION 3.13.1)

find_package(Zephyr REQUIRED HINTS $ENV{ZEPHYR_BASE})
project(mqtt_google_cloud)

if(NOT EXISTS ${APPLICATION_SOURCE_DIR}/src/private_info/key.c)
    message(FATAL_ERROR "!!!!!! Generate key file before continuing !!!!!!")
endif()

# NORDIC SDK APP START
target_sources(app PRIVATE src/main.c)
target_sources(app PRIVATE src/gcloud.c)
target_sources(app PRIVATE src/private_info/key.c)
# NORDIC SDK APP END
zephyr_include_directories(src)

# Include application events and configuration headers
zephyr_library_include_directories(
  include
)
```

## prj.conf
```kconfig
# App config
CONFIG_GCLOUD_LOG_LEVEL=4
CONFIG_WATCHDOG=n
CONFIG_ASSERT=y
CONFIG_REBOOT=y
CONFIG_AT_HOST_LIBRARY=y

# General config
CONFIG_NEWLIB_LIBC_FLOAT_PRINTF=y
CONFIG_NEWLIB_LIBC=y
CONFIG_CJSON_LIB=y

# Debug settings
CONFIG_SERIAL=y
CONFIG_LOG=y
CONFIG_LOG_PRINTK=n
CONFIG_LOG_DEFAULT_LEVEL=4
# CONFIG_LOG_BACKEND_SHOW_COLOR=y
# CONFIG_LOG_BACKEND_UART=y
# CONFIG_LOG_BACKEND_RTT=n

# # Optimisation
# CONFIG_NO_OPTIMIZATIONS=y
# CONFIG_DEBUG=y

# Expand logging memory to avoid log_strdup() errors
CONFIG_LOG_STRDUP_MAX_STRING=256
CONFIG_LOG_STRDUP_BUF_COUNT=12

# LTE link control
CONFIG_LTE_LINK_CONTROL=y
CONFIG_LTE_AUTO_INIT_AND_CONNECT=n
CONFIG_LTE_LINK_CONTROL_LOG_LEVEL_DBG=n

CONFIG_LTE_NETWORK_MODE_NBIOT=n
CONFIG_LTE_NETWORK_MODE_LTE_M=y
CONFIG_LTE_NETWORK_USE_FALLBACK=n

CONFIG_DATE_TIME_UPDATE_INTERVAL_SECONDS=0

CONFIG_LTE_LEGACY_PCO_MODE=n
CONFIG_LTE_PSM_REQ_RPTAU="00000110"
CONFIG_LTE_PSM_REQ_RAT="00000010"
# CONFIG_LTE_PSM_REQ_RPTAU="10100000"
# CONFIG_LTE_PSM_REQ_RAT="11100000"

# BSD library
CONFIG_BSD_LIBRARY=y
CONFIG_DATE_TIME=y
CONFIG_DATE_TIME_MODEM=y
CONFIG_DATE_TIME_UPDATE_INTERVAL_SECONDS=3600
CONFIG_SNTP=y
CONFIG_FP_HARDABI=y
# CONFIG_DATE_TIME_LOG_LEVEL_DBG=y

# Disable Modem traces, since we need UART1 for HCI
CONFIG_BSD_LIBRARY_TRACE_ENABLED=n

# Networking
CONFIG_NETWORKING=y
CONFIG_NET_NATIVE=y
# CONFIG_NET_LOG=y

CONFIG_NET_SOCKETS=y
CONFIG_NET_SOCKETS_OFFLOAD=y
CONFIG_NET_SOCKETS_POSIX_NAMES=y
# CONFIG_NET_SOCKETS_LOG_LEVEL_DBG=y

CONFIG_NET_IPV4=y
CONFIG_NET_IPV6=n
CONFIG_NET_TCP=y
CONFIG_NET_UDP=y

# nRF9160 helper libraries
CONFIG_MODEM_KEY_MGMT=y
CONFIG_DNS_RESOLVER=y
CONFIG_MODEM_INFO=y

# Main thread
CONFIG_MAIN_THREAD_PRIORITY=7
CONFIG_UART_INTERRUPT_DRIVEN=y

# Google Cloud
CONFIG_GCLOUD_REGION="europe-west1"
CONFIG_GCLOUD_PROJECT_NAME="nordic-91-test"
CONFIG_GCLOUD_REGISTRY_NAME="nrf9160_testing"
CONFIG_GCLOUD_DEVICE_NAME="nrf_960075737"

# JSON
CONFIG_JSON_LIBRARY=y

# JWT
CONFIG_JWT=y
CONFIG_JWT_SIGN_ECDSA=y

# MQTT
CONFIG_MQTT_LIB=y
CONFIG_MQTT_LIB_TLS=y
CONFIG_MQTT_MESSAGE_BUFFER_SIZE=1024
CONFIG_MQTT_PAYLOAD_BUFFER_SIZE=1024

# Heap and stacks
CONFIG_HEAP_MEM_POOL_SIZE=16384
CONFIG_MAIN_STACK_SIZE=8192
CONFIG_SYSTEM_WORKQUEUE_STACK_SIZE=2048
CONFIG_HW_STACK_PROTECTION=y

# Enable settings storage
CONFIG_SETTINGS=y
```

## src/main.c
```c
/*
 * Copyright (c) 2020 Safecility.com
 * Author: tad@safecility.com
 */

#include <zephyr.h>
#include <device.h>

#include <stdio.h>
#include <stdlib.h>
#include <string.h>
#include <errno.h>

#include <power/reboot.h>

#include <nrf_modem.h>
#include <modem/lte_lc.h>
#include <modem/modem_info.h>

#include <nrf_socket.h>
#include <net/socket.h>
#include <net/mqtt.h>

#include <date_time.h>
#include <gcloud.h>
#include <cJSON.h>

/* Size of buffer determines update rate */
#define MAX_MESSAGE_SIZE 256

struct app_message {
	char data[MAX_MESSAGE_SIZE];
	size_t len;
};

/* Register main module log */
LOG_MODULE_REGISTER(google_mqtt, CONFIG_GCLOUD_LOG_LEVEL);

/* Stack definition for application */
static K_THREAD_STACK_DEFINE(gc_stack_area, 4096);

/* Threads */
static struct k_thread gc_thread;

k_tid_t gc_tid;

struct m_info_t
{
    char cid[30];
    char tac[30];
    char rssi[30];
    char apn[60];
    char fwv[60];
    uint16_t vltg;
    uint16_t temp;
};

/* Semaphores */
static K_SEM_DEFINE(date_time_ok, 0, 1);

/* Global Variables */

/* Forward declarations of functions */
static void store_modem_configuration(void);

/* Handlers */
void button_handler(uint32_t button_state, uint32_t has_changed)
{
    LOG_INF("Button event: %x  %x\n", button_state, has_changed);
    if ((has_changed & 0x01) && (button_state & 0x01))
    {
        store_modem_configuration();
    }
}

/**@brief Handler for when receiving data from Google Cloud */
void received_config_handler(const struct mqtt_publish_message *message)
{

    cJSON *data_json = cJSON_Parse(message->payload.data);
    cJSON_Delete(data_json);
}

/**@brief Configures modem to provide LTE link. Blocks until link is
 * successfully established
 */
static void modem_configure(void)
{
    if (IS_ENABLED(CONFIG_LTE_AUTO_INIT_AND_CONNECT))
    {
        /* Do nothing, modem is already turned on and connected */
    }
    else
    {
        int err;

        //LOG_INF("Enabling PSM\n");
        /* Enable PSM mode */
        //lte_lc_psm_req(true);

        LOG_INF("Establishing LTE link\n");
        err = lte_lc_init_and_connect();
        __ASSERT(err == 0, "LTE link could not be established. Rebooting\n");
    }
}

/**@brief Soft boots modem to store current values to NVM */
void store_modem_configuration(void)
{
    int err;

    LOG_INF("Storing modem configuration\n");
    err = lte_lc_power_off();
    if (err)
    {
        LOG_INF("Fail turning off modem: %d\n", err);
    }
    LOG_INF("Modem offline, turning back on\n");

    err = lte_lc_normal();
    if (err)
    {
        LOG_INF("Fail turning on modem: %d\n", err);
    }
    LOG_INF("Done\n");
}

/**@brief Return modem information */
void get_modem_info(struct m_info_t *info)
{
    LOG_INF("Getting modem info\n");
    modem_info_string_get(MODEM_INFO_CELLID, info->cid, sizeof(info->cid));
    modem_info_string_get(MODEM_INFO_AREA_CODE, info->tac, sizeof(info->tac));
    modem_info_string_get(MODEM_INFO_RSRP, info->rssi, sizeof(info->rssi));
    modem_info_string_get(MODEM_INFO_APN, info->apn, sizeof(info->apn));
    modem_info_string_get(MODEM_INFO_FW_VERSION, info->fwv, sizeof(info->fwv));
    modem_info_short_get(MODEM_INFO_BATTERY, &info->vltg);
    modem_info_short_get(MODEM_INFO_TEMP, &info->temp);
}

void date_time_handler(const struct date_time_evt *evt) {

	switch (evt->type)
	{
	case DATE_TIME_OBTAINED_MODEM:
		LOG_DBG("DATE_TIME: got time from modem.\n");
		k_sem_give(&date_time_ok);
		break;
	case DATE_TIME_OBTAINED_NTP:
		LOG_DBG("DATE_TIME: got time from NTP.\n");
		k_sem_give(&date_time_ok);
		break;
	case DATE_TIME_OBTAINED_EXT:
		LOG_DBG("DATE_TIME: got time from external.\n");
		k_sem_give(&date_time_ok);
		break;
	case DATE_TIME_NOT_OBTAINED:
		LOG_DBG("DATE_TIME: failed to get time.\n");
		k_sem_give(&date_time_ok);
		break;
	default:
		break;
	}
}

void create_message(struct app_message* destination, uint8_t *data, size_t len, int64_t *timestamp) {

	cJSON *message;

	message = cJSON_CreateObject();

    cJSON_AddStringToObject(message, "type", "test message");

	char time_str[16];
	snprintf(time_str, 16, "%lld", *timestamp);

	char data_str[len];
	snprintf(data_str, len, "%s", data);

	cJSON_AddStringToObject(message, "timestamp", time_str);
	cJSON_AddStringToObject(message, "data", data);

	destination->len = strlen(cJSON_Print(message));

	strcpy(destination->data, cJSON_Print(message));

	cJSON_Delete(message);
}

/**@brief Thread initialisation */
void main(void)
{
    int err;

    LOG_INF("Google Cloud env sensor app started");

    LOG_INF("Initializing modem\n");
    modem_configure();

    LOG_INF("Initializing modem info\n");
    modem_info_init();

    date_time_update_async(date_time_handler);
    k_sem_take(&date_time_ok, K_FOREVER);

    /* Initialise Google Cloud thread */
    gc_tid = k_thread_create(&gc_thread, gc_stack_area, K_THREAD_STACK_SIZEOF(gc_stack_area),
                             (k_thread_entry_t)gcloud_thread, NULL, NULL, NULL,
                             7, 0, K_NO_WAIT);


    err = gcloud_provision();
    if (err)
    {
        LOG_ERR("Provisioning failed, error: %d\n", err);
        /* Reboot */
        sys_reboot(0); //TODO: Handle error
    }

    /* Connect to Google Cloud */
    LOG_INF("Connecting to Google Cloud\n");
    err = gcloud_connect(received_config_handler);
    if (err)
    {
        LOG_ERR("Failed to connect to Google Cloud, error: %d\n", err);
        /* Reboot */
        sys_reboot(0); //TODO: Handle error
    }
    else
    {
        LOG_INF("Connected to Google Cloud\n");
    }
    
    int pub_success;
    uint32_t cnt = 0;

    while (true)
    {
        //Get timestamp
	    int64_t curr_time;
	    date_time_now(&curr_time);

        struct app_message message;
        create_message(&message, "x", sizeof("x"), &curr_time);

        pub_success = gcloud_publish(message.data, message.len, MQTT_QOS_1_AT_LEAST_ONCE);
        if (pub_success != 0)
        {
            LOG_INF("JSON data Publish failed\n");
        }
        
        cnt++;
        k_sleep(K_SECONDS(10));
    }
}
```

## include/gcloud.h
```c
#ifndef __MQTT_H__
#define __MQTT_H__

#include <net/mqtt.h>

#define strlens(s) (s==NULL?0:strlen(s))

typedef void (*received_config_handler_t)(const struct mqtt_publish_message *message);

/**
 * @brief Publishes data to Google Cloud.
 * 
 * @param[in] data A pointer to the data to be sent.
 * @param[in] size The size of the data to be sent.
 * @param[in] qos The Quality of Serive level to be used when sending the telemetry.
 * 
 * @note Google Cloud does only support QoS 0 and QoS 1, not QoS 2
 * 
 * @retval 0 or an error code indicating reason for failure.
 */
// CANDO: Make it possible to publish gps to subtopics
int gcloud_publish(uint8_t *data, uint32_t size, enum mqtt_qos qos);

/**
 * @brief Publishes device state to Google Cloud.
 * 
 * @param[in] data A pointer to the data to be sent.
 * @param[in] size The size of the data to be sent.
 * @param[in] qos The Quality of service level to be used when sending the state.
 * 
 * @note Google Cloud does only support QoS 0 and QoS 1, not Qos 2.
 * @note Google Cloud limits state updates to 1 update per second, per device. 
 *       However, for best results, device state should be updated much less often 
 *       - at most, once every 10 second.
 * 
 * @retval 0 or an error code indicating reson for failure.
 */
int gcloud_publish_state(uint8_t *data, uint32_t size, enum mqtt_qos qos);

/**
 * @brief Connects the device to Google Cloud, and subscribes to Google Cloud's configuration topic.
 * 
 * @note gcloud_provision must be called before this.
 * @note Shall be called before trying to send data to Google Cloud.
 * @note The modem must be turned on, and connected before this function can be called.
 * 
 * @param[in] received_config_cb Callback function which will be called when a configuration 
 *            update is received from Google Cloud.
 * 
 * @retval - or an error code indicating reason for failure.
 */
// CANDO: make it possible to set keep-alive checks, and input check intervals
// CANDO: make it possible to decide what QoS level the subscription to config should be
int gcloud_connect(received_config_handler_t received_config_cb);

/**
 * @brief Initializes the module and provisions the modem so that an TLS 
 * connection can be established to Google Cloud.
 * 
 * @note Shall be called before the modem is turned on.
 * @note Shall be called before gcloud_connect.
 * @note If module initialization fails, no module APIs shall be called.
 * 
 * @retval 0 or an error code indicating reason for failure.
 */
int gcloud_provision(void);

/**
 * @brief Disconnects the device from Google Cloud.
 * 
 * @retval 0 or an error code indicating reason for failure.
 */
int gcloud_disconnect(void);

/**
 * @brief Google Cloud Thread entry.
 */
extern void gcloud_thread(void *unused1, void *unused2, void *unused3);

#endif /* __MQTT_H__ */
```

## src/gcloud.c
```c
#include<logging/log.h>

#include <zephyr.h>
#include <kernel.h>
#include <string.h>
#include <errno.h>

#include <date_time.h>

#include <net/mqtt.h>
#include <net/socket.h>
#include <net/tls_credentials.h>

#include <data/jwt.h>

#include <modem/modem_key_mgmt.h>
#include <nrf_modem.h>

#include "gcloud.h"

#include "globalsign.inc"

#define ROOT_CERT \
    "-----BEGIN CERTIFICATE-----\n" \
    "MIIBdTCCARugAwIBAgIJAOvj4PVfAgqjMAoGCCqGSM49BAMCMBYxFDASBgNVBAMM\n" \
    "C25yZjkxLW1hcnRlMCAXDTE5MDQwNTExMTUxN1oYDzQ3NTcwMzAyMTExNTE3WjAW\n" \
    "MRQwEgYDVQQDDAtucmY5MS1tYXJ0ZTBZMBMGByqGSM49AgEGCCqGSM49AwEHA0IA\n" \
    "BAq8otkWGnocpdAxlnpJdVn6EBb1WbQnZXLFaYzsMeXWGFIIO02hWTvaSUPI1xNs\n" \
    "0QB8c3IU9oBhDXkRNU2Nqi2jUDBOMB0GA1UdDgQWBBRLAhO335CAd280I/qVQmiM\n" \
    "07nd8TAfBgNVHSMEGDAWgBRLAhO335CAd280I/qVQmiM07nd8TAMBgNVHRMEBTAD\n" \
    "AQH/MAoGCCqGSM49BAMCA0gAMEUCIF2kQO7Cqn73ANmwBdgGA1y/KGOpOU4I/ywF\n" \
    "LEu8trOUAiEA8//UWttMRkmaylghw3mgsYGGKk17rY+4j+4mGUwvDnw=\n" \
    "-----END CERTIFICATE-----"

#define GCLOUD_CA_CERTIFICATE ROOT_CERT

#define GCLOUD_ID "projects/" CONFIG_GCLOUD_PROJECT_NAME "/locations/" CONFIG_GCLOUD_REGION "/registries/" CONFIG_GCLOUD_REGISTRY_NAME "/devices/" CONFIG_GCLOUD_DEVICE_NAME

#define GCLOUD_HOSTNAME "mqtt.googleapis.com" 
#define BROKER_ADDR GCLOUD_HOSTNAME
#define BROKER_PORT 8883

#define GCLOUD_SEC_TAG 16842752
#define SUBSCRIBE_ID 42

#define MQTT_INPUT_PERIOD K_SECONDS(2)
#define MQTT_LIVE_PERIOD K_SECONDS(55)
#define GCLOUD_DISCONNECT_INTERVAL K_HOURS(12)
#define INPUT_TIMEOUT_PERIOD K_SECONDS(10)

#define GCLOUD_CONFIG_TOPIC "/devices/" CONFIG_GCLOUD_DEVICE_NAME "/config"
#define GCLOUD_STATE_TOPIC "/devices/" CONFIG_GCLOUD_DEVICE_NAME "/state"
#define GCLOUD_TOPIC "/devices/" CONFIG_GCLOUD_DEVICE_NAME "/events"

#define JWT_BUFFER_SIZE 256

#define GCLOUD_THREAD_STACK_SIZE 2048

#define GCLOUD_THREAD_PRIORITY 7

LOG_MODULE_REGISTER(gcloud);

/* Buffers for MQTT client. */
static uint8_t rx_buffer[CONFIG_MQTT_MESSAGE_BUFFER_SIZE];
static uint8_t tx_buffer[CONFIG_MQTT_MESSAGE_BUFFER_SIZE];

static K_SEM_DEFINE(gc_connected_sem, 0, 1);

extern void gcloud_thread(void *, void *, void *);

enum gcloud_event_type {
    CONNECT,
    INPUT_TIMEOUT,
    LIVE_TIMEOUT,
    PUBLISH_STATE,
    PUBLISH,
    RECONNECT_TIMEOUT,
    DISCONNECT,
    SUBSCRIBE
};

struct empty {};

union gcloud_event_param {
    struct empty connect;
    struct empty input_timeout;
    struct empty live_timeout;
    struct mqtt_publish_message publish_state; // This could be a whole mqtt message, thus allowing custom topics
    struct mqtt_publish_message publish;
    struct empty reconnect_timeout;
    struct empty disconnect;
    struct empty subscribe; // Here we could add the list of topics to be subscribed to
};

struct gcloud_event {
    enum gcloud_event_type type;
    union gcloud_event_param param;
};

static struct mqtt_client client;
static struct sockaddr_storage mqtt_broker;
static struct mqtt_sec_config tls_config;

char jwt_buffer[JWT_BUFFER_SIZE];
static struct mqtt_utf8 jwt_token = {
    .utf8 = jwt_buffer
};
static struct mqtt_utf8 username = {
    .utf8 = "unused",
    .size = sizeof("unused")
};

static struct mqtt_topic gcloud_topics_list[] = {
    {
        .topic = {
            .utf8 = GCLOUD_CONFIG_TOPIC,
            .size = sizeof(GCLOUD_CONFIG_TOPIC) - 1
        },
        .qos = MQTT_QOS_1_AT_LEAST_ONCE
    }
};

/* Private key information */
extern unsigned char zepfull_private_der[];
extern unsigned int zepfull_private_der_len;

static received_config_handler_t received_config_handler = NULL;

#define N_MESSAGES 3
K_MSGQ_DEFINE(gcloud_msgq, sizeof(struct gcloud_event), N_MESSAGES, 4);

static void mqtt_event_handler(struct mqtt_client *client, const struct mqtt_evt *evt);

void input_timer_handler(struct k_timer *timer_id);
void reconnect_timer_handler(struct k_timer *timer_id);
K_TIMER_DEFINE(input_timer, input_timer_handler, NULL);
K_TIMER_DEFINE(reconnect_timer, reconnect_timer_handler, NULL);

int k_msgq_get_atomic(struct k_msgq *q, void *data, k_timeout_t timeout);
int k_msgq_put_atomic(struct k_msgq *q, void *data, k_timeout_t timeout);

static bool connected = false;
static bool connecting = false;


/**@brief Resolves the configured hostname and
 * initializes the MQTT broker structure
 */
static void broker_init(void)
{
    int err;
    struct addrinfo *result;
    struct addrinfo *addr;
    struct addrinfo hints = {
        .ai_family = AF_INET,
        .ai_socktype = SOCK_STREAM
    };

    err = getaddrinfo(GCLOUD_HOSTNAME, NULL, &hints, &result);
    if (err) {
        LOG_ERR("ERROR: getaddrinfo failed [%d] %s", err, strerror(err));
        return;
    }

    addr = result;
    err = -ENOENT;

    /* Look for address of the broker. */
    while (addr != NULL) {
        /* IPv4 Address. */
        if (addr->ai_addrlen == sizeof(struct sockaddr_in)) {
            struct sockaddr_in *broker4 =
                ((struct sockaddr_in *)&mqtt_broker);

            broker4->sin_addr.s_addr =
                ((struct sockaddr_in *)addr->ai_addr)
                ->sin_addr.s_addr;
            broker4->sin_family = AF_INET;
            broker4->sin_port = htons(BROKER_PORT);
            
            LOG_DBG("IPv4 Address found 0x%08x",
                broker4->sin_addr.s_addr);
            break;
        } else {
            LOG_ERR("ai_addrlen = %u should be %u or %u",
                (unsigned int)addr->ai_addrlen,
                (unsigned int)sizeof(struct sockaddr_in),
                (unsigned int)sizeof(struct sockaddr_in6));
        }

        addr = addr->ai_next;
        break;
    }

    /* Free the address. */
    freeaddrinfo(result);
}

static int make_jwt(char *buffer, size_t buffer_size) {

    int err;
    struct jwt_builder jb;

    err = jwt_init_builder(&jb, buffer, buffer_size);
    if (err != 0) {
        LOG_ERR("Unable to init JWT builder: %d", err);
        return err;
    }

    /* Get Unix time from modem thread and mask upper bits */
    int64_t ntp;
    date_time_now(&ntp);

    int64_t unixtime = (ntp/1000);    //TODO: Is unix time valid as jwt timestamp?
    int32_t y = (int32_t)unixtime;

    LOG_DBG("Unix Timestamp: %d\n", y);
    int32_t expiry_time = (y + (12 * 60 * 60));
    int32_t issue_time = y;

    err = jwt_add_payload(&jb, expiry_time, issue_time, CONFIG_GCLOUD_PROJECT_NAME);
    if (err != 0) {
        LOG_ERR("Unable to add JWT payload: %d", err);
        return err;
    }
    err = jwt_sign(&jb, zepfull_private_der, zepfull_private_der_len);
    if (err != 0) {
        LOG_ERR("Unable to add JWT payload: %d", err);
        return err;
    }
    if (jb.overflowed != 0) {
        LOG_ERR("JWT buffer overflowed");
        return -ENOMEM;
    }
    return err;
}

static int gcloud_subscribe() {
    const struct mqtt_subscription_list subscriptions = {
        .list = (struct mqtt_topic *)&gcloud_topics_list,
        .list_count = ARRAY_SIZE(gcloud_topics_list),
        .message_id = SUBSCRIBE_ID
    };

    return mqtt_subscribe(&client, &subscriptions);
}

static int client_init(void) {

    mqtt_client_init(&client);

    int err = make_jwt(jwt_buffer, JWT_BUFFER_SIZE);
    if (err != 0) {
        LOG_ERR("Unable to make jwt: [%d] %s", err, strerror(-err));
        return err;
    }

    LOG_DBG("JWT:\n%s\n", log_strdup(jwt_buffer));
    LOG_DBG("JWT length: %d\n", strlen(jwt_buffer));
    jwt_token.size = strlen(jwt_buffer);

    client.broker = &mqtt_broker;

    /* MQTT client configuration */
    client.evt_cb = mqtt_event_handler;
    client.client_id.utf8 = (uint8_t *)GCLOUD_ID;
    client.client_id.size = strlen(GCLOUD_ID);

	client.password = &jwt_token;
	client.user_name = &username;

    client.protocol_version = MQTT_VERSION_3_1_1;

	/* MQTT buffers configuration */
	client.rx_buf = rx_buffer;
	// client.rx_buf_size = sizeof(rx_buffer);
    client.rx_buf_size = 512;

	client.tx_buf = tx_buffer;
	// client.tx_buf_size = sizeof(tx_buffer);
    client.tx_buf_size = 1024;

    /* MQTT transport configuration */
	client.transport.type = MQTT_TRANSPORT_SECURE;

    /* Session */
    client.clean_session = 1;
    client.keepalive = 120;

    return 0;
}

int gcloud_connect(received_config_handler_t received_config_cb) {
    int err = 0;
    received_config_handler = received_config_cb;

    // send connect command
    struct gcloud_event msg = {
        .type = CONNECT
    };
    err = k_msgq_put_atomic(&gcloud_msgq, &msg, K_FOREVER);

    k_sem_take(&gc_connected_sem, K_FOREVER);

    return err;
}

int gcloud_disconnect() {
    int err = 0;

    // send disconnect command
    struct gcloud_event msg = {
        .type = DISCONNECT
    };
    err = k_msgq_put_atomic(&gcloud_msgq, &msg, K_FOREVER);

    return err;
}

// CANDO: Merge publish functions, and only have one publish command
// (the public API can still have two separate functions)
int gcloud_publish(uint8_t *data, uint32_t size, enum mqtt_qos qos)
{
    int err;
    if (!connected) {
        LOG_WRN("Cannot publish data while not connected to Google Cloud");
        return -ENOTCONN;
    }

    struct gcloud_event cmd = {
        .type = PUBLISH,
        .param.publish = {
            .topic = {
                .topic = {
                    .utf8 = GCLOUD_TOPIC,
                    .size = strlen(GCLOUD_TOPIC)
                },
                .qos = qos
            },
            .payload = {
                .data = data,
                .len = size
            }
        }
    };

    err = k_msgq_put_atomic(&gcloud_msgq, &cmd, K_FOREVER);

    return err;
}

int gcloud_publish_state(uint8_t *data, uint32_t size, enum mqtt_qos qos)
{
    int err;
    if (!connected) {
        LOG_WRN("Cannot publish state while not connected to Google Cloud");
        return -ENOTCONN;
    }
    struct gcloud_event state_cmd = {
        .type = PUBLISH_STATE,
        .param.publish_state = {
            .topic = {
                .topic = {
                    .utf8 = GCLOUD_STATE_TOPIC,
                    .size = strlen(GCLOUD_STATE_TOPIC)
                },
                .qos = qos
            },
            .payload = {
                .data = data,
                .len = size
            }
        }
    };
    err = k_msgq_put_atomic(&gcloud_msgq, &state_cmd, K_FOREVER);
    return err;
}

int k_msgq_get_atomic(struct k_msgq *q, void *data, k_timeout_t timeout){
    unsigned int key = irq_lock();
    int temp = k_msgq_get(q, data, timeout);
    irq_unlock(key);
    return temp;
}

int k_msgq_put_atomic(struct k_msgq *q, void *data, k_timeout_t timeout){
    unsigned int key = irq_lock();
    int temp = k_msgq_put(q,data, timeout);
    irq_unlock(key);
    return temp;
}

void input_timer_handler(struct k_timer *timer_id) {
    struct gcloud_event cmd = {
        .type = INPUT_TIMEOUT,
        .param = {}
    };
    int err = k_msgq_put(&gcloud_msgq, &cmd, K_NO_WAIT);
    if (err) {
        LOG_ERR("k_msgq_put (input_timeout) failed: [%d] %s", err, strerror(-err));
        // TODO: Find a way to report this error to the application.
    }
}

void reconnect_timer_handler(struct k_timer *timer_id) {
    struct gcloud_event cmd = {
        .type = RECONNECT_TIMEOUT,
        .param = {}
    };
    int err = k_msgq_put(&gcloud_msgq, &cmd, K_NO_WAIT);

    if (err) {
        LOG_ERR("k_msgq_put (reconnect_timeout) failed: [%d] %s", err, strerror(err));
        // TODO: Find a way to report this error to the application.
    }
}

int gcloud_provision(void) {

    int err;

    /* Security configuration */
    static sec_tag_t sec_tag_list[] = {GCLOUD_SEC_TAG};
    tls_config = (client.transport).tls.config;

	tls_config.peer_verify = 0;
    tls_config.hostname = NULL;

	tls_config.cipher_list = NULL;

	tls_config.cipher_count = 0;
	tls_config.sec_tag_count = ARRAY_SIZE(sec_tag_list);
	tls_config.sec_tag_list = sec_tag_list;
	tls_config.hostname = GCLOUD_HOSTNAME;

    /* Delete certificates */
    nrf_sec_tag_t sec_tag = GCLOUD_SEC_TAG;

    for (enum modem_key_mgmt_cred_type type = 0; type < 5; type++) {
        err = modem_key_mgmt_delete(sec_tag, type);
        if (err) {
            LOG_ERR("key delete err: [%d] %s", err, strerror(err));
        }
    }
    // LOG_DBG("CERT:\n%s\n", GCLOUD_CA_CERTIFICATE);
    /* Provision CA Certificate */
    err = modem_key_mgmt_write(
        GCLOUD_SEC_TAG,
        MODEM_KEY_MGMT_CRED_TYPE_CA_CHAIN,
        GCLOUD_CA_CERTIFICATE,
        strlen(GCLOUD_CA_CERTIFICATE));
    if (err != 0) {
        LOG_ERR("GCLOUD_CA_CERTIFICATE err: [%d] %s\n", err, strerror(err));
        return err;
    }

    // This function should probably only be called once.
    // connecting = true;
    // err = mqtt_connect(&client);

    return 0;
}

static void mqtt_event_handler(struct mqtt_client *client,
                const struct mqtt_evt *evt)
{
    int err = 0;
    LOG_INF("MQTT event: %d", evt->type);

    switch (evt->type) {
        /* Response to connack request */
        case MQTT_EVT_CONNACK:
            LOG_DBG("Got CONNACK");
            if (evt->result != 0) {
                LOG_ERR("MQTT connect failed: [%d] %s", evt->result, strerror(evt->result));
                break;
            }

            k_sem_give(&gc_connected_sem);

            connected = true;
            connecting = false;
            k_timer_start(&reconnect_timer, GCLOUD_DISCONNECT_INTERVAL, GCLOUD_DISCONNECT_INTERVAL);

            #ifdef CONFIGURATION_SUBSCRIPTION
            struct gcloud_event cmd = {
                .type = SUBSCRIBE,
                .param.subscribe = {}
            };

            err = k_msgq_put_atomic(&gcloud_msgq, &cmd, K_FOREVER);

            if (err) {
                LOG_ERR("k_msgq_put_atomic (subscribe) failed: [%d] %s", err, strerror(err));
                // TODO: Find a way to report this error to the application.
            }
            #endif

            break;

        /* Message has been published to a topic we subscribe to */
        case MQTT_EVT_PUBLISH:
            LOG_DBG("MQTT PUBLISH event");
            if (evt->result != 0) {
                LOG_ERR("Publish event error: [%d] %s", evt->result, strerror(-evt->result));
            }

            if (evt->param.publish.message.topic.qos == MQTT_QOS_1_AT_LEAST_ONCE) {
                const struct mqtt_puback_param ack = {
                    .message_id = evt->param.publish.message_id
                };

                /* Send ack */
                mqtt_publish_qos1_ack(client, &ack);
                LOG_INF("Send acknowledgement");
            }

            if(evt->param.publish.message.payload.len <= 2) {
                LOG_WRN("Received empty payload");
                break;
            }

            LOG_DBG("Length of payload: %d", evt->param.publish.message.payload.len);
            LOG_DBG("Topic: %s", log_strdup(evt->param.publish.message.topic.topic.utf8));
            LOG_DBG("QoS: %d", evt->param.publish.message.topic.qos);
            LOG_DBG("Message:\n");

            struct mqtt_evt event = *evt;

            char * str = calloc(evt->param.publish.message.payload.len, sizeof(char) + 1);
            memcpy(str, evt->param.publish.message.payload.data, evt->param.publish.message.payload.len);
            event.param.publish.message.payload.data = str;

            if (received_config_handler != NULL) {
                received_config_handler(&event.param.publish.message);
            }

            free(str);
            break;

        /* Dissconnect event. MQTT Client Reference is no longer valid. */
        case MQTT_EVT_DISCONNECT:
            LOG_DBG("MQTT client disconnected: [%d] %s", evt->result, strerror(-evt->result));
            k_timer_stop(&input_timer);
            k_timer_stop(&reconnect_timer);
            // If we are connected, something has gone wrong, and we would like to reconnect
            // CANDO: Notify the application that we are attempting a reconnect
            
            // Purge message queue to make sure that there are no old messages waiting
            k_msgq_purge(&gcloud_msgq);


            if (connected || connecting) {
                err = gcloud_connect(received_config_handler);
                if (err) {
                    LOG_ERR("k_msgq_put_atomic (reconnect) [%d] %s", err, strerror(err));
                    // TODO: Find a way to report this error to the application.
                }
            }
            break;

        /* Acknowledgement for QoS 1 messages */
        case MQTT_EVT_PUBACK:
            if (evt->result != 0) {
                LOG_ERR("MQTT PUBACK error: %d", evt->result);
                break;
            }

            LOG_DBG("PUBACK packet id: %d\n", evt->param.puback.message_id);

            break;

        /* Reception confirmation for messages with QoS 2 */
        case MQTT_EVT_PUBREC:
            if (evt->result != 0) {
                LOG_ERR("MQTT PUBREC error: %d", evt->result);
                break;
            }

            LOG_DBG("PUBREC packet id: %u", evt->param.pubrec.message_id);

            const struct mqtt_pubrel_param rel_param = {
                .message_id = evt->param.pubrec.message_id
            };

            err = mqtt_publish_qos2_release(client, &rel_param);
            if (err != 0) {
                LOG_ERR("Failed to send MQTT PUBREL: [%d] %s", err, strerror(err));
            }

            break;

        /* Release of messages with QoS 2 */
        case MQTT_EVT_PUBREL:
            LOG_DBG("MQTT PUBREL event");
            if (evt->result != 0) {
                LOG_ERR("PUBREL error: %d", evt->result);
                break;
            }
            break;

        /* Confirmation to publish */
        case MQTT_EVT_PUBCOMP:
            if (evt->result != 0) {
                LOG_ERR("MQTT PUBCOMP error: %d", evt->result);
                break;
            }

            LOG_DBG("PUBCOMP packet id: %u", evt->param.pubcomp.message_id);

            break;

        /* Ack of a subscription request */
        case MQTT_EVT_SUBACK:
            LOG_DBG("Got SUBACK");
            if (evt->result != 0) {
                LOG_ERR("MQTT SUBACK error: %d", evt->result);
                break;
            }

            break;

        /* Ack of an unsubscribe request */
        case MQTT_EVT_UNSUBACK:
            LOG_DBG("MQTT UNSUBACK event");
            if (evt->result != 0) {
                LOG_ERR("MQTT UNSUBACK error: %d", evt->result);
                break;
            }

            break;
        
        default:
            LOG_ERR("Unknown mqtt event type");
            break;
    }
}

extern void gcloud_thread(void *unused1, void *unused2, void *unused3) 
{
    int err;
    bool sent_flag = false;

    struct gcloud_event event;
    struct mqtt_publish_param msg;

    k_timer_init(&input_timer, input_timer_handler, NULL);
    k_timer_init(&reconnect_timer, reconnect_timer_handler, NULL);


    LOG_INF("Google Cloud Thread Running\n");
    while (true) {

        k_msgq_get_atomic(&gcloud_msgq, &event, K_FOREVER);

        switch (event.type) {
            case CONNECT:
                LOG_INF("Got CONNECT command");
                LOG_DBG("Initiating broker");
                broker_init();

                LOG_DBG("Making JWT");
                make_jwt(jwt_buffer, JWT_BUFFER_SIZE);

                LOG_DBG("Initiating client");
                client_init();

                LOG_DBG("Starting input timer");
                k_timer_start(&input_timer, INPUT_TIMEOUT_PERIOD, INPUT_TIMEOUT_PERIOD);

                LOG_DBG("Connecting mqtt");
                connecting = true;
                err = mqtt_connect(&client);
                if (err) {
                    LOG_ERR("mqtt_connect failed: [%d] %s", err, strerror(-err));
                    // TODO: Find a way to report this error to the application.
                }

                break;
            case INPUT_TIMEOUT:
                LOG_INF("Got INPUT_TIMEOUT command");
                err = mqtt_input(&client);
                if (err) {
                    LOG_ERR("mqtt_input failed: [%d] %s", err, strerror(-err));
                    // TODO: Find a way to report this error to the application.
                } 
            break;
            case LIVE_TIMEOUT:
            if (connected) {
                LOG_INF("Got LIVE_TIMEOUT command");
                err = mqtt_live(&client);
                if (err) {
                    LOG_ERR("mqtt_live failed: [%d] %s", err, strerror(-err));
                    // TODO: Find a way to report this error to the application.
                }
            }
            break;
            case PUBLISH_STATE:
            if (connected) {
                LOG_INF("Got PUBLISH_STATE command");
                msg.message = event.param.publish_state;
                msg.message_id = k_uptime_get_32();
                msg.dup_flag = 0;
                msg.retain_flag = 0;
                err = mqtt_publish(&client, &msg);
                
                if (err) {
                    LOG_ERR("mqtt_publish (state) failed: [%d] %s", err, strerror(-err));
                    // TODO: Find a way to report this error to the application.
                }
            };
            break;
            // CANDO: Merge these publish cases?
            case PUBLISH:
            if (connected) {
                LOG_INF("Got PUBLISH command");
                msg.message = event.param.publish;
                msg.message_id = k_uptime_get_32();
                msg.dup_flag = 0;
                msg.retain_flag = 0;
                err = mqtt_publish(&client, &msg);
                if (err) {
                    LOG_ERR("mqtt_publish failed: [%d] %s", err, strerror(-err));
                    // TODO: Find a way to report this error to the application.
                }
                sent_flag = true;
            };
            break;
            case RECONNECT_TIMEOUT:
                LOG_INF("Got RECONNECT_TIMEOUT command");
            case DISCONNECT:
                LOG_INF("Got DISCONNECT command");
            if (connected) {
                k_timer_stop(&reconnect_timer);
                LOG_DBG("Disconnecting mqtt");
                err = mqtt_disconnect(&client);
                if (err) {
                    LOG_ERR("mqtt_disconnect (reconnect) failed: [%d] %s", err, strerror(-err));
                    // TODO: Find a way to report this error to the application.
                }
                /* purge message queue */
                k_msgq_purge(&gcloud_msgq);

                connected = false;
                if (event.type == DISCONNECT) {
                    LOG_DBG("Not setting connecting flag");
                    connecting = false;
                } else {
                    connecting = true;
                }

            };
            break;
            case SUBSCRIBE:
            if (connected) {
                LOG_INF("Got SUBSCRIBE command");
                err = gcloud_subscribe();
                if (err) {
                    LOG_ERR("gcloud_subscribe failed: [%d] %s", err, strerror(-err));
                    // TODO: Find a way to report this error to the application.
                }
            };
            break;
            default:
                LOG_ERR("Unknown event type received");
                // TODO: Find a way to report this error to the application.
        }
        /* If a message has been sent */
        if (sent_flag == true) {
           sent_flag = false;
        }
    }
}
```

## src/gcloud_rework.h
```c
/*
 * Copyright (c) 2019 Nordic Semiconductor ASA
 *
 * SPDX-License-Identifier: LicenseRef-Nordic-5-Clause
 */

/**@file
 *@brief AWS IoT library header.
 */

#ifndef AWS_IOT_H__
#define AWS_IOT_H__

#include <stdio.h>
#include <net/mqtt.h>

/**
 * @defgroup aws_iot AWS IoT library
 * @{
 * @brief Library to connect the device to the GCloud IoT Core message broker.
 */

#ifdef __cplusplus
extern "C" {
#endif

/** @brief AWS IoT shadow topics, used in messages to specify which shadow
 *         topic that will be published to.
 */
enum gcloud_topic_type {
	/** Unknown device shadow topic. */
	GCLOUD_TOPIC_UNKNOWN = 0x0,
	/** This topic type corresponds to
	 *  $aws/things/<thing-name>/shadow/get, publishing an empty message
	 *  to this topic requests the device shadow document.
	 */
	GCLOUD_TOPIC_GET,
	/** This topic type corresponds to
	 *  $aws/things/<thing-name>/shadow/update, publishing data to this
	 *  topic updates the device shadow document.
	 */
	GCLOUD_TOPIC_UPDATE,
	/** This topic type corresponds to
	 *  $aws/things/<thing-name>/shadow/delete, publishing an empty message
	 *  to this topic deletes the device Shadow document.
	 */
	GCLOUD_TOPIC_DELETE
};

/**@ AWS broker disconnect results. */
enum gcloud_disconnect_result {
	GCLOUD_DISCONNECT_USER_REQUEST,
	GCLOUD_DISCONNECT_CLOSED_BY_REMOTE,
	GCLOUD_DISCONNECT_INVALID_REQUEST,
	GCLOUD_DISCONNECT_MISC,
	GCLOUD_DISCONNECT_COUNT
};

/**@brief AWS broker connect results. */
enum gcloud_connect_result {
	GCLOUD_CONNECT_RES_SUCCESS = 0,
	GCLOUD_CONNECT_RES_ERR_NOT_INITD = -1,
	GCLOUD_CONNECT_RES_ERR_INVALID_PARAM = -2,
	GCLOUD_CONNECT_RES_ERR_NETWORK = -3,
	GCLOUD_CONNECT_RES_ERR_BACKEND = -4,
	GCLOUD_CONNECT_RES_ERR_MISC = -5,
	GCLOUD_CONNECT_RES_ERR_NO_MEM = -6,
	/* Invalid private key */
	GCLOUD_CONNECT_RES_ERR_PRV_KEY = -7,
	/* Invalid CA or client cert */
	GCLOUD_CONNECT_RES_ERR_CERT = -8,
	/* Other cert issue */
	GCLOUD_CONNECT_RES_ERR_CERT_MISC = -9,
	/* Timeout, SIM card may be out of data */
	GCLOUD_CONNECT_RES_ERR_TIMEOUT_NO_DATA = -10,
	GCLOUD_CONNECT_RES_ERR_ALREADY_CONNECTED = -11,
};

/** @brief AWS IoT notification event types, used to signal the application. */
enum gcloud_evt_type {
	/** Connecting to AWS IoT broker. */
	GCLOUD_EVT_CONNECTING = 0x1,
	/** Connected to AWS IoT broker. */
	GCLOUD_EVT_CONNECTED,
	/** AWS IoT library has subscribed to all configured topics. */
	GCLOUD_EVT_READY,
	/** Disconnected to AWS IoT broker. */
	GCLOUD_EVT_DISCONNECTED,
	/** Data received from AWS message broker. */
	GCLOUD_EVT_DATA_RECEIVED,
	/** AWS IoT library irrecoverable error. */
	GCLOUD_EVT_ERROR
};

/** @brief AWS IoT topic data. */
struct gcloud_topic_data {
	/** Type of shadow topic that will be published to. */
	enum gcloud_topic_type type;
	/** Pointer to string of application specific topic. */
	const char *str;
	/** Length of application specific topic. */
	size_t len;
};

/** @brief Structure used to declare a list of application specific topics
 *         passed in by the application.
 */
struct gcloud_app_topic_data {
	/** List of application specific topics. */
	struct mqtt_topic list[CONFIG_AWS_IOT_APP_SUBSCRIPTION_LIST_COUNT];
	/** Number of entries in topic list. */
	size_t list_count;
};

/** @brief AWS IoT transmission data. */
struct gcloud_data {
	/** Topic data is sent/received on. */
	struct gcloud_topic_data topic;
	/** Pointer to data sent/received from the AWS IoT broker. */
	char *ptr;
	/** Length of data. */
	size_t len;
	/** Quality of Service of the message. */
	enum mqtt_qos qos;
};

/** @brief Struct with data received from AWS IoT broker. */
struct gcloud_evt {
	/** Type of event. */
	enum gcloud_evt_type type;
	union {
		struct aws_iot_data msg;
		int err;
		bool persistent_session;
	} data;
};

/** @brief AWS IoT library asynchronous event handler.
 *
 *  @param[in] evt The event and any associated parameters.
 */
typedef void (*gcloud_evt_handler_t)(const struct gcloud_evt *evt);

/** @brief Structure for AWS IoT broker connection parameters. */
struct gcloud_config {
	/** Socket for AWS IoT broker connection */
	int socket;
	/** Client id for AWS IoT broker connection, used when
	 *  @option{CONFIG_AWS_IOT_CLIENT_ID_APP} is set. If not set an internal
	 *  configurable static client id is used.
	 */
	char *client_id;
	/** Length of client_id string. */
	size_t client_id_len;
};

/** @brief Initialize the module.
 *
 *  @warning This API must be called exactly once, and it must return
 *           successfully.
 *
 *  @param[in] config Pointer to struct containing connection parameters.
 *  @param[in] event_handler Pointer to event handler to receive AWS IoT module
 *                           events.
 *
 *  @return 0 If successful.
 *            Otherwise, a (negative) error code is returned.
 */
int gcloud_init(const struct aws_iot_config *const config,
		 aws_iot_evt_handler_t event_handler);

/** @brief Connect to the AWS IoT broker.
 *
 *  @details This function exposes the MQTT socket to main so that it can be
 *           polled on.
 *
 *  @param[out] config Pointer to struct containing connection parameters,
 *                     the MQTT connection socket number will be copied to the
 *                     socket entry of the struct.
 *
 *  @return 0 If successful.
 *            Otherwise, a (negative) error code is returned.
 */
int gcloud_connect(struct aws_iot_config *const config);

/** @brief Disconnect from the AWS IoT broker.
 *
 *  @return 0 If successful.
 *            Otherwise, a (negative) error code is returned.
 */
int gcloud_disconnect(void);

/** @brief Send data to AWS IoT broker.
 *
 *  @param[in] tx_data Pointer to struct containing data to be transmitted to
 *                     the AWS IoT broker.
 *
 *  @return 0 If successful.
 *            Otherwise, a (negative) error code is returned.
 */
int gcloud_send(const struct aws_iot_data *const tx_data);

/** @brief Get data from AWS IoT broker
 *
 *  @return 0 If successful.
 *            Otherwise, a (negative) error code is returned.
 */
int gcloud_input(void);

/** @brief Ping AWS IoT broker. Must be called periodically
 *         to keep connection to broker alive.
 *
 *  @return 0 If successful.
 *            Otherwise, a (negative) error code is returned.
 */
int gcloud_ping(void);

/** @brief Add a list of application specific topics that will be subscribed to
 *         upon connection to AWS IoT broker.
 *
 *  @param[in] topic_list Pointer to list of topics.
 *  @param[in] list_count Number of entries in the list.
 *
 *  @return 0 If successful.
 *            Otherwise, a (negative) error code is returned.
 */
int gcloud_subscription_topics_add(
			const struct aws_iot_topic_data *const topic_list,
			size_t list_count);

#ifdef __cplusplus
}
#endif

/**
 *@}
 */

#endif /* AWS_IOT_H__ */
```
