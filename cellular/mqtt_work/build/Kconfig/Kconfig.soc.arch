## cellular/mqtt_work/build/Kconfig/Kconfig.soc.arch
```kconfig
osource "C:/Users/cafo/ncs/my_ncs/ncs/zephyr/soc/$(ARCH)/Kconfig"
osource "C:/Users/cafo/ncs/my_ncs/ncs/zephyr/soc/$(ARCH)/*/Kconfig"
```

## cellular/nrf_to_gcloud_with_ble/build_thingy91_nrf9160ns/spm/Kconfig/Kconfig.soc.arch
```kconfig
osource "C:/ncs/zephyr/soc/$(ARCH)/Kconfig"
osource "C:/ncs/zephyr/soc/$(ARCH)/*/Kconfig"
```

## peripheral_zephyr/spi/build_secure/Kconfig/Kconfig.shield
```kconfig
osource "C:/ncs/nrf/boards/shields/*/Kconfig.shield"
osource "C:/ncs/zephyr/boards/shields/*/Kconfig.shield"
```

## peripheral_zephyr/spi/build_secure/Kconfig/Kconfig.shield.defconfig
```kconfig
osource "C:/ncs/nrf/boards/shields/*/Kconfig.defconfig"
osource "C:/ncs/zephyr/boards/shields/*/Kconfig.defconfig"
```
